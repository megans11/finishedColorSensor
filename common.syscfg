// These arguments were used when this file was generated. They will be automatically applied on subsequent loads 
// via the GUI or CLI invocations. Run CLI with '--help' for additional information on how to override these arguments.
// @cliArgs --board "/ti/boards/CC3220SF_LAUNCHXL" --product "SimpleLinkSDK@3.20.00.06"
// @versions {"data":"2019051709","timestamp":"2019051709","tool":"1.1.792","templates":"2019051709"}

// Add a SENSORS BoosterPack boosterpack
var BOOSTXL_SENSORS = scripting.addHardware("/ti/boards/boosterpacks/BOOSTXL-SENSORS");
var SimpleLinkWifi = scripting.addModule("/ti/drivers/net/wifi/SimpleLinkWifi");
var Display = scripting.addModule("/ti/display/Display");
var DMA = scripting.addModule("/ti/drivers/DMA");
var GPIO = scripting.addModule("/ti/drivers/GPIO");
var Timer = scripting.addModule("/ti/drivers/Timer");
var Watchdog = scripting.addModule("/ti/drivers/Watchdog");
var Display1 = Display.addInstance();
var Timer1 = Timer.addInstance();
var Watchdog1 = Watchdog.addInstance();
var SPI = scripting.addModule("/ti/drivers/SPI");
var SPI1 = SPI.addInstance();
var GPIO1 = GPIO.addInstance();
var I2C = scripting.addModule("/ti/drivers/I2C");
var I2C1 = I2C.addInstance();
var GPIO2 = GPIO.addInstance();
var GPIO3 = GPIO.addInstance();
var GPIO4 = GPIO.addInstance();
var Board = scripting.addModule("/ti/drivers/Board");
var Power = scripting.addModule("/ti/drivers/Power");
// IO Retention Shutdown - IO groups to be retained during Shutdown
Power.ioRetentionShutdown = ["GRP_1"];
// Name
Power.parkPins.$name = "ti_drivers_power_PowerCC32XXPins0";
// Name - The C/C++ identifier used in applications as the index parameter passed to Display runtime APIs
Display1.$name = "Board_Display0";
// Use Hardware - Select the hardware to use, or 'none' to use available header pins
Display1.$hardware = system.deviceData.board.components.xds110Uart;
// Use DMA
Display1.uart.useDMA = true;
// Name - The C/C++ identifier used in applications as the index parameter passed to UART runtime APIs
Display1.uart.$name = "UART_USB";
// Name
Display1.uart.uart.$name = "MyUART1";
// Use Peripheral
Display1.uart.uart.$assign = "UART0";
// Assign pin
Display1.uart.uart.txPin.$assign = "GP01"; // pin number - 55
// Assign pin
Display1.uart.uart.rxPin.$assign = "GP02"; // pin number - 57
// Assign pin
Display1.uart.uart.txDmaChannel.$assign = "UDMA_CH9";
// Assign pin
Display1.uart.uart.rxDmaChannel.$assign = "UDMA_CH8";
// Timer Type
Timer1.timerType = "32 Bits";
// Name - The C/C++ identifier used in applications as the index parameter passed to Timer runtime APIs
Timer1.$name = "COLOR_SENSOR_TIMER";
// Name
Timer1.timer.$name = "MyTimer1";
// Use Peripheral
Timer1.timer.$assign = "Timer0";
// Name - The C/C++ identifier used in applications as the index parameter passed to Watchdog runtime APIs
Watchdog1.$name = "Board_WATCHDOG0";
// Name
Watchdog1.watchdog.$name = "MyWATCHDOG1";
// Use Peripheral
Watchdog1.watchdog.$assign = "WATCHDOG0";
// Name - The C/C++ identifier used in applications as the index parameter passed to SPI runtime APIs
SPI1.$name = "Board_SPI0";
// Mode - In three pin mode the SS signal is not used.
SPI1.mode = "Four Pin SS Active Low";
// Name
SPI1.spi.$name = "MySPI1";
// Name - The C/C++ identifier used in applications as the index parameter passed to GPIO runtime APIs
GPIO1.$name = "Board_GPIO0";
// Name - The C/C++ identifier used in applications as the index parameter passed to I2C runtime APIs
I2C1.$name = "COLOR_SENSOR_I2C0";
// Name
I2C1.i2c.$name = "MyI2C1";
// Assign pin
I2C1.i2c.sdaPin.$assign = "boosterpack.14"; // P06
// Assign pin
I2C1.i2c.sclPin.$assign = "boosterpack.4"; // P03
// Name - The C/C++ identifier used in applications as the index parameter passed to GPIO runtime APIs
GPIO2.$name = "COLOR_TASK_LED";
// Use Hardware - Select the hardware to use, or 'none' to use available header pins
GPIO2.$hardware = system.deviceData.board.components.LED_YELLOW;
// Name - The C/C++ identifier used in applications as the index parameter passed to GPIO runtime APIs
GPIO3.$name = "Board_GPIO1";
// Use Hardware - Select the hardware to use, or 'none' to use available header pins
GPIO3.$hardware = system.deviceData.board.components.LED_GREEN;
// Name - The C/C++ identifier used in applications as the index parameter passed to GPIO runtime APIs
GPIO4.$name = "Board_GPIO2";
// Use Hardware - Select the hardware to use, or 'none' to use available header pins
GPIO4.$hardware = system.deviceData.board.components.LED_RED;
// Suggest solution
SPI1.spi.$suggestSolution = "SPI0";
// Suggest solution
SPI1.spi.sclkPin.$suggestSolution = "5";
// Suggest solution
SPI1.spi.misoPin.$suggestSolution = "53";
// Suggest solution
SPI1.spi.mosiPin.$suggestSolution = "7";
// Suggest solution
SPI1.spi.ssPin.$suggestSolution = "50";
// Suggest solution
SPI1.spi.dmaRxChannel.$suggestSolution = "UDMA_CH30";
// Suggest solution
SPI1.spi.dmaTxChannel.$suggestSolution = "UDMA_CH31";
// Suggest solution
GPIO1.gpioPin.$suggestSolution = "8";
// Suggest solution
I2C1.i2c.$suggestSolution = "I2C0";
// Suggest solution
GPIO2.gpioPin.$suggestSolution = "1";
// Suggest solution
GPIO3.gpioPin.$suggestSolution = "2";
// Suggest solution
GPIO4.gpioPin.$suggestSolution = "64";
